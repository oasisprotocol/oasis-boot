## build/conf/local.conf
```bitbake
MACHINE ?= "tdx"
DISTRO ?= "oasis-vm"

PATCHRESOLVE = "noop"

BB_DISKMON_DIRS ??= "\
    STOPTASKS,${TMPDIR},1G,100K \
    STOPTASKS,${DL_DIR},1G,100K \
    STOPTASKS,${SSTATE_DIR},1G,100K \
    STOPTASKS,/tmp,100M,100K \
    HALT,${TMPDIR},100M,1K \
    HALT,${DL_DIR},100M,1K \
    HALT,${SSTATE_DIR},100M,1K \
    HALT,/tmp,10M,1K"

BB_HASHSERVE_UPSTREAM = 'wss://hashserv.yoctoproject.org/ws'
SSTATE_MIRRORS ?= "file://.* http://cdn.jsdelivr.net/yocto/sstate/all/PATH;downloadfilename=PATH"

BB_HASHSERVE = "auto"
BB_SIGNATURE_HANDLER = "OEEquivHash"

CONF_VERSION = "2"
```

## meta-oasis-vm/conf/distro/oasis-vm.conf
```bitbake
# Distribution definition for Oasis VM.
require conf/distro/poky.conf
require conf/distro/include/gcsections.inc

DISTRO = "oasis-vm"
DISTRO_NAME = "Oasis VM"
DISTRO_VERSION = "0.1.0"
DISTROOVERRIDES = "poky:oasis-vm"
TCLIBC = "glibc"

FULL_OPTIMIZATION="-Os -pipe ${DEBUG_FLAGS}"

PREFERRED_PROVIDER_virtual/kernel = "linux-yocto-tiny"
PREFERRED_VERSION_linux-yocto-tiny ?= "6.12%"

POKY_DEFAULT_EXTRA_RRECOMMENDS = ""
TCLIBCAPPEND = ""

# Disable wide char support for ncurses as we don't include it in
# in the LIBC features below.
# Leave native enable to avoid build failures
ENABLE_WIDEC = "false"
ENABLE_WIDEC:class-native = "true"

# Drop native language support. This removes the
# eglibc->bash->gettext->libc-posix-clang-wchar dependency.
USE_NLS="no"
# As we don't have native language support, don't install locales into images
IMAGE_LINGUAS = ""

DISTRO_FEATURES_TINY = "pci ext4"
DISTRO_FEATURES_NET = "ipv4 ipv6"
# Introduce a custom feature that can be used by other recipes to detect being
# built for Oasis VM.
DISTRO_FEATURES_OASISVM = "oasisvm"
# Features needed for containers.
DISTRO_FEATURES_CONTAINERS = "seccomp"

DISTRO_FEATURES = "${DISTRO_FEATURES_TINY} \
                   ${DISTRO_FEATURES_NET} \
                   ${DISTRO_FEATURES_OASISVM} \
                   ${DISTRO_FEATURES_CONTAINERS} \
                  "

OASIS_VM_DISTRO_FEATURES_NATIVE = "acl debuginfod ext2 ipv4 ipv6 xattr nfs zeroconf pci vfat seccomp ptest"

DISTRO_FEATURES:class-native = "${OASIS_VM_DISTRO_FEATURES_NATIVE} tpm2"
DISTRO_FEATURES:class-nativesdk = "${OASIS_VM_DISTRO_FEATURES_NATIVE} tpm2"

# Configure container networking backend.
VIRTUAL-RUNTIME_container_networking = "netavark"
VIRTUAL-RUNTIME_container_dns = "aardvark-dns"

# add /dev/sd* disk config
KERNEL_EXTRA_FEATURES:append = " features/scsi/disk.scc"

# enable mdev/busybox for init
#POKY_INIT_MANAGER:oasis-vm = "mdev-busybox"

# FIXME: Consider adding "modules" to MACHINE_FEATURES and using that in
# packagegroup-core-base to select modutils-initscripts or not.  Similar with "net" and
# netbase.

# By default we only support initramfs. We don't build live as that
# pulls in a lot of dependencies for the live image and the installer, like
# udev, grub, etc.  These pull in gettext, which fails to build with wide
# character support.
IMAGE_FSTYPES = "wic wic.vhd"
QB_DEFAULT_FSTYPE = "wic"

INITRAMFS_IMAGE = "oasis-vm-stage1"
# Include the initramfs in the kernel image so we avoid the need for two files.
INITRAMFS_IMAGE_BUNDLE = "1"

# Drop v86d from qemu dependency list (we support serial)
# Drop grub from meta-intel BSPs
# FIXME: A different mechanism is needed here. We could define -tiny
#        variants of all compatible machines, but that leads to a lot
#        more machine configs to maintain long term.
MACHINE_ESSENTIAL_EXTRA_RDEPENDS = ""

# The mtrace script included by eglibc is a perl script. This means the system
# will build perl in case this package is installed. Since we don't care about
# this script for the purposes of tiny, remove the dependency from here.
RDEPENDS:${PN}-mtrace:pn-eglibc = ""

SKIP_RECIPE[build-appliance-image] = "not buildable with oasis-vm"
SKIP_RECIPE[core-image-rt] = "not buildable with oasis-vm"
SKIP_RECIPE[core-image-rt-sdk] = "not buildable with oasis-vm"
SKIP_RECIPE[core-image-sato] = "not buildable with oasis-vm"
SKIP_RECIPE[core-image-sato-dev] = "not buildable with oasis-vm"
SKIP_RECIPE[core-image-sato-sdk] = "not buildable with oasis-vm"
SKIP_RECIPE[core-image-x11] = "not buildable with oasis-vm"
SKIP_RECIPE[core-image-weston] = "not buildable with oasis-vm"

# Disable python usage in opkg-utils since it won't build with tiny config
PACKAGECONFIG:remove:pn-opkg-utils = "python"
```

## meta-oasis-vm/conf/layer.conf
```bitbake
# We have a conf and classes directory, append to BBPATH.
BBPATH .= ":${LAYERDIR}"

# We have a recipes directory, add to BBFILES.
BBFILES += "${LAYERDIR}/recipes-*/*/*.bb \
            ${LAYERDIR}/recipes-*/*/*.bbappend"

BBFILE_COLLECTIONS += "oasis-vm"
BBFILE_PATTERN_oasis-vm := "^${LAYERDIR}/"
BBFILE_PRIORITY_oasis-vm = "20"
LAYERVERSION_oasis-vm = "1"
LAYERDEPENDS_oasis-vm = "virtualization-layer"
LAYERSERIES_COMPAT_oasis-vm = "scarthgap"
```

## meta-oasis-vm/conf/machine/tdx.conf
```bitbake
#@TYPE: Machine
#@NAME: QEMU x86-64 machine
#@DESCRIPTION: Machine configuration for running an x86-64 system on QEMU
#
# from require conf/machine/include/qemu.inc
# Don't include kernels in standard images
RDEPENDS:${KERNEL_PACKAGE_NAME}-base = ""

# Use a common kernel recipe for all QEMU machines
PREFERRED_PROVIDER_virtual/kernel ??= "linux-yocto-tiny"

EXTRA_IMAGEDEPENDS += "qemu-system-native qemu-helper-native:do_addto_recipe_sysroot"

# from require conf/machine/include/x86/qemuboot-x86.inc
# NOTE: The QB_* configuration options below are only for runqemu.
IMAGE_CLASSES += "qemuboot"
QB_SMP ?= "-smp 4"
QB_CPU:x86 ?= "-cpu IvyBridge -machine q35,i8042=off"
QB_CPU_KVM:x86 ?= "-cpu IvyBridge -machine q35,i8042=off"

QB_CPU:x86-64 ?= "-cpu IvyBridge -machine q35,i8042=off"
QB_CPU_KVM:x86-64 ?= "-cpu IvyBridge -machine q35,i8042=off"

QB_KERNEL_CMDLINE_APPEND = "oprofile.timer=1 tsc=reliable no_timer_check rcupdate.rcu_expedited=1"
QB_OPT_APPEND = "-usb -device usb-tablet -usb -device usb-kbd"

QB_SYSTEM_NAME = "tdx"

DEFAULTTUNE ?= "x86-64-v3"

require conf/machine/include/x86/tune-x86-64-v3.inc

KERNEL_IMAGETYPE = "bzImage"

SERIAL_CONSOLES ?= "115200;ttyS0 115200;ttyS1"

MACHINE_FEATURES += "x86 pci tpm2 tdx"
```

## meta-poky-patches/conf/layer.conf
```bitbake
# We have a conf and classes directory, append to BBPATH.
BBPATH .= ":${LAYERDIR}"

# We have a recipes directory, add to BBFILES.
BBFILES += "${LAYERDIR}/recipes-*/*/*.bb \
            ${LAYERDIR}/recipes-*/*/*.bbappend"

BBFILE_COLLECTIONS += "poky-patches"
BBFILE_PATTERN_poky-patches := "^${LAYERDIR}/"
BBFILE_PRIORITY_poky-patches = "20"
LAYERVERSION_poky-patches = "1"
LAYERSERIES_COMPAT_poky-patches = "scarthgap"
```
